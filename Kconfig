## Kconfig
```kconfig
menu "MyAsyncTcp组件配置"
    config SERVER_BACKLOG_LEN
        int "服务器监听时，等待连接最大长度"
        default 32
    
    config SEND_POOL_CHUNK
        int "发送管理缓冲区数量"
        default 24
        range 16 32
        help 
            "所有连接共享的发送管理缓冲区数量"
            "发送缓冲区仅管理发送数据，不存储数据"

    config CONNECTION_CLEAN_TIME
        int "连接清理时间（秒）"
        default 30
        help 
            "连接会在指定的时间内进行重用"

    config CONNECTION_POOL_KEEP
        int "池收缩后保留的空闲连接数"
        default 1
        range 0 16
        help
            收缩只保留这么多个空闲对象，其余析构并还内存。
            0 表示每次收缩都清空空闲对象（下次连接需要重新分配）。
            注意：收缩只动空闲对象，正在用的连接不受影响。
endmenu
```
